## drivers/muchannel/Kconfig
```kconfig
config MUCHANNEL
	bool "Muen shared memory channels"
	---help---
	  This option is selected by any driver that uses the Muen shared memory
	  channels.

	  If unsure, say 'N'.
```

## drivers/muen/Kconfig
```kconfig
menu "Muen driver support"

config MUEN_CHANNEL
	bool "Muen shared memory channels"
	depends on MUEN_GUEST
	help
	  Muen shared memory channels are an implementation of the SHMStream
	  Version 2 IPC protocol (shmstream). This option is selected by any
	  driver that uses Muen shared memory channels.

config MUEN_SINFO
	bool "Muen subject information driver"
	depends on MUEN_GUEST
	default n
	help
	  The Muen subject information driver provides data about the execution
	  environment to other Muen modules.

endmenu
```
